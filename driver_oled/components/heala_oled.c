#include "heala_oled.h" // add libirary
#include "esp_log.h"

#define ESP_SDA 22             // SDA pin
#define ESP_SCL 21             // SCL pin
#define ESP_I2C_Port I2C_NUM_0 // Gate of I2C (Gate 0)
#define DATA_LENGTH 100

static uint16_t oled_addr = -1;
static const char *TAG_I2C = "I2C_oled";
static i2c_master_bus_handle_t ESP_handle;
static i2c_master_dev_handle_t oled_handle;

const uint8_t font5x7_basic[95][5] = {
    {0x00, 0x00, 0x00, 0x00, 0x00}, // (space)
    {0x00, 0x00, 0x5F, 0x00, 0x00}, // !
    {0x00, 0x07, 0x00, 0x07, 0x00}, // "
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    {0x08, 0x04, 0x08, 0x10, 0x08}  // ~
};

const uint8_t pin_100[65] = {0xf8, 0x08, 0xf8, 0xf8, 0xf8, 0xf8, 0xf8, 0x08, 0x08, 0xf8, 0xf8, 0xf8,
                             0xf8, 0xf8, 0x08, 0x08, 0xf8, 0xf8, 0xf8, 0xf8, 0xf8, 0x08, 0x08, 0xf8,
                             0xf8, 0xf8, 0xf8, 0xf8, 0x08, 0xf8, 0x80, 0x80, 0x1f, 0x10, 0x1f, 0x1f,
                             0x1f, 0x1f, 0x1f, 0x10, 0x10, 0x1f, 0x1f, 0x1f, 0x1f, 0x1f, 0x10, 0x10,
                             0x1f, 0x1f, 0x1f, 0x1f, 0x1f, 0x10, 0x10, 0x1f, 0x1f, 0x1f, 0x1f, 0x1f,
                             0x10, 0x1f, 0x01, 0x01};

const uint8_t pin_75[65] = {0xf8, 0x08, 0xf8, 0xf8, 0xf8, 0xf8, 0xf8, 0x08, 0x08, 0xf8, 0xf8, 0xf8,
                            0xf8, 0xf8, 0x08, 0x08, 0xf8, 0xf8, 0xf8, 0xf8, 0xf8, 0x08, 0x08, 0x08,
                            0x08, 0x08, 0x08, 0x08, 0x08, 0xf8, 0x80, 0x80, 0x1f, 0x10, 0x1f, 0x1f,
                            0x1f, 0x1f, 0x1f, 0x10, 0x10, 0x1f, 0x1f, 0x1f, 0x1f, 0x1f, 0x10, 0x10,
                            0x1f, 0x1f, 0x1f, 0x1f, 0x1f, 0x10, 0x10, 0x10, 0x10, 0x10, 0x10, 0x10,
                            0x10, 0x1f, 0x01, 0x01};

const uint8_t pin_50[65] = {0xf8, 0x08, 0xf8, 0xf8, 0xf8, 0xf8, 0xf8, 0x08, 0x08, 0xf8, 0xf8, 0xf8,
                            0xf8, 0xf8, 0x08, 0x08, 0x08, 0x08, 0x08, 0x08, 0x08, 0x08, 0x08, 0x08,
                            0x08, 0x08, 0x08, 0x08, 0x08, 0xf8, 0x80, 0x80, 0x1f, 0x10, 0x1f, 0x1f,
                            0x1f, 0x1f, 0x1f, 0x10, 0x10, 0x1f, 0x1f, 0x1f, 0x1f, 0x1f, 0x10, 0x10,
                            0x10, 0x10, 0x10, 0x10, 0x10, 0x10, 0x10, 0x10, 0x10, 0x10, 0x10, 0x10,
                            0x10, 0x1f, 0x01, 0x01};

const uint8_t pin_25[65] = {0xf8, 0x08, 0xf8, 0xf8, 0xf8, 0xf8, 0xf8, 0x08, 0x08, 0x08, 0x08, 0x08,
                            0x08, 0x08, 0x08, 0x08, 0x08, 0x08, 0x08, 0x08, 0x08, 0x08, 0x08, 0x08,
                            0x08, 0x08, 0x08, 0x08, 0x08, 0xf8, 0x80, 0x80, 0x1f, 0x10, 0x1f, 0x1f,
                            0x1f, 0x1f, 0x1f, 0x10, 0x10, 0x10, 0x10, 0x10, 0x10, 0x10, 0x10, 0x10,
                            0x10, 0x10, 0x10, 0x10, 0x10, 0x10, 0x10, 0x10, 0x10, 0x10, 0x10, 0x10,
                            0x10, 0x1f, 0x01, 0x01};

const uint8_t pin_0[65] = {0xf8, 0x08, 0x08, 0x08, 0x08, 0x08, 0x08, 0x08, 0x08, 0x08, 0x08, 0x08,
                           0x08, 0x08, 0x08, 0x08, 0x08, 0x08, 0x08, 0x08, 0x08, 0x08, 0x08, 0x08,
                           0x08, 0x08, 0x08, 0x08, 0x08, 0xf8, 0x80, 0x80, 0x1f, 0x10, 0x10, 0x10,
                           0x10, 0x10, 0x10, 0x10, 0x10, 0x10, 0x10, 0x10, 0x10, 0x10, 0x10, 0x10,
                           0x10, 0x10, 0x10, 0x10, 0x10, 0x10, 0x10, 0x10, 0x10, 0x10, 0x10, 0x10,
                           0x10, 0x1f, 0x01, 0x01};
const uint8_t bluetooth[13] = {
    0x10, 0xA0, 0xFE, 0x44, 0xA8, 0x10, 0x01, 0x00, 0x0F, 0x04, 0x02, 0x01};

const uint8_t noBluetooth[13] = {
    0x00, 0x00, 0x00, 0x00, 0x00, 0x00, 0x00, 0x00, 0x00, 0x00, 0x00};

const uint8_t wifi[27] = {
    0x10, 0x08, 0x24, 0x12, 0x4A, 0x2A, 0xAA, 0x2A, 0x4A, 0x12, 0x24, 0x08, 0x10,
    0x00, 0x00, 0x00, 0x00, 0x00, 0x01, 0x03, 0x01, 0x00, 0x00, 0x00, 0x00, 0x00};

const uint8_t noWifi[27] = {
    0x00, 0x00, 0x00, 0x00, 0x00, 0x00, 0x00, 0x00, 0x00, 0x00, 0x00, 0x00, 0x00, 0x00, 0x00, 0x00, 0x00, 0x00, 0x00, 0x00, 0x00, 0x00, 0x00, 0x00, 0x00, 0x00};

const uint8_t health[31] = {
    0xf0, 0xf8, 0xfc, 0xfc, 0xfc, 0xfc, 0xf8, 0xf0, 0xf8, 0xfc, 0xfc, 0xfc,
    0xfc, 0xf8, 0xf0, 0x01, 0x03, 0x07, 0x0f, 0x1f, 0x3f, 0x7f, 0xff, 0x7f,
    0x3f, 0x1f, 0x0f, 0x07, 0x03, 0x01};

const uint8_t movebutton[6] = {
    0x10, 0x92, 0x54, 0x38, 0x10};

const uint8_t HRV[37] = {
    0xff, 0x01, 0x01, 0x01, 0x01, 0x81, 0xf1, 0x1d, 0xf1, 0x01, 0x01, 0x01, 0x81, 0x01,
    0x01, 0x01, 0x01, 0xff, 0xff, 0x80, 0x80, 0x81, 0x81, 0x81,
    0x80, 0x80, 0x87, 0x98, 0x8c, 0x83, 0x81, 0x81, 0x81, 0x80, 0x80, 0xff};
// function private
static void
i2c_scanner(i2c_master_bus_handle_t bus_handle)
{
    ESP_LOGI(TAG_I2C, "Scanning I2C bus...");

    // Quét tất cả địa chỉ từ 1 -> 126
    for (int addr = 1; addr < 127; addr++)
    {
        // Thử gửi 0 byte để xem có ACK
        esp_err_t ret = i2c_master_probe(bus_handle, addr, 1000);

        if (ret == ESP_OK)
        {
            if (ret == ESP_OK)
            {
                ESP_LOGI(TAG_I2C, "Found device at 0x%02X", addr);
                oled_addr = addr;
            }
        }
    }
}

static void i2c_master_slave_init()
{
    // config master (ESP)
    i2c_master_bus_config_t esp_config = {
        .clk_source = I2C_CLK_SRC_DEFAULT,
        .i2c_port = ESP_I2C_Port,
        .scl_io_num = ESP_SCL,
        .sda_io_num = ESP_SDA,
        .glitch_ignore_cnt = 7,
        .flags.enable_internal_pullup = true,
    };
    ESP_ERROR_CHECK(i2c_new_master_bus(&esp_config, &ESP_handle));
    // i2c scanner
    i2c_scanner(ESP_handle);

    if (oled_addr > 0)
    {
        // config slave (oled)
        i2c_device_config_t oled_config = {
            .dev_addr_length = I2C_ADDR_BIT_LEN_7,
            .device_address = oled_addr,
            .scl_speed_hz = 100000,
        };
        ESP_ERROR_CHECK(i2c_master_bus_add_device(ESP_handle, &oled_config, &oled_handle));
    }
    else
    {
        ESP_LOGI(TAG_I2C, "No found");
    }
}

static void oled_draw(const uint8_t *bitmap, uint8_t size, uint8_t col_start, uint8_t col_finish, uint8_t page_start, uint8_t page_finish)
{
    config_position(col_start, col_finish, page_start, page_finish);
    for (int i = 0; i < size; i++)
    {
        master_transmit_data(bitmap[i]);
    }
}

// public function
void master_transmit_cmd(uint8_t *cmd_wr, uint8_t byte)
{
    i2c_master_transmit(oled_handle, cmd_wr, byte, 1000);
}

void master_transmit_data(uint8_t data_wr)
{
    uint8_t buffer[3] = {0x40, data_wr};
    i2c_master_transmit(oled_handle, buffer, 2, 1000);
}

void oled_init()
{
    i2c_master_slave_init();

    // Enable charge pumpb regulator
    master_transmit_cmd((uint8_t[]){0x00, 0x8D, 0x14}, 3);

    // SET MUX RATIO
    master_transmit_cmd((uint8_t[]){0x00, 0xA8, 0x3F}, 3);

    // SET DISPLAY OFFSET
    master_transmit_cmd((uint8_t[]){0x00, 0xD3, 0x00}, 3);

    // Set Display Start line
    master_transmit_cmd((uint8_t[]){0x00, 0x40}, 2);

    // Set Segment re-map
    master_transmit_cmd((uint8_t[]){0x00, 0xA0, 0xA1}, 3);

    // Set COM Output Scan Direction
    master_transmit_cmd((uint8_t[]){0x00, 0xC0, 0xC8}, 3);

    // Set COM Pins hardware configuration
    master_transmit_cmd((uint8_t[]){0x00, 0xDA, 0x12}, 3);

    // Set Osc Frequency
    master_transmit_cmd((uint8_t[]){0x00, 0xD5, 0x80}, 3);

    // Set Contrast Control
    master_transmit_cmd((uint8_t[]){0x00, 0x81, 0x7F}, 3);

    // Set VCOMH Deselect level
    master_transmit_cmd((uint8_t[]){0x00, 0xDB, 0x20}, 3);

    // Disable Entire Display On
    master_transmit_cmd((uint8_t[]){0x00, 0xA4}, 2);

    // Set Normaln Display
    master_transmit_cmd((uint8_t[]){0x00, 0xA6}, 2);

    // Set Memory Addressing Mode
    master_transmit_cmd((uint8_t[]){0x00, 0x20, 0x02}, 3);

    // Display On
    master_transmit_cmd((uint8_t[]){0x00, 0xAF}, 2);
}

void oled_clear()
{
    master_transmit_cmd((uint8_t[]){0x00, 0x20, 0x02}, 3); // Page mode
    config_position(0, 127, 0, 7);                         // Toàn màn

    // Gửi dữ liệu trắng từng page
    for (uint8_t page = 0; page < 8; page++)
    {
        config_position(0, 127, page, page);
        for (uint8_t col = 0; col < 128; col++)
        {
            master_transmit_data(0x00);
        }
    }
}

void oled_clear_data(uint8_t page_start, uint8_t page_finish, uint8_t col_start, uint8_t col_finish)
{
    master_transmit_cmd((uint8_t[]){0x00, 0x20, 0x02}, 3);

    for (uint8_t page = page_start; page <= page_finish; page++)
    {
        config_position(col_start, col_finish, page, page);
        for (uint8_t col = col_start; col < col_finish; col++)
        {
            master_transmit_data(0x00);
        }
    }
}

void config_position(uint8_t col_start, uint8_t col_finish, uint8_t page_start, uint8_t page_finish)
{
    // Set column address
    uint8_t buffer_col[4];
    buffer_col[0] = 0x00;
    buffer_col[1] = 0x21;
    buffer_col[2] = col_start;
    buffer_col[3] = col_finish;
    master_transmit_cmd(buffer_col, 4);

    // Set page address
    uint8_t buffer_page[4];
    buffer_page[0] = 0x00;
    buffer_page[1] = 0x22;
    buffer_page[2] = page_start;
    buffer_page[3] = page_finish;
    master_transmit_cmd(buffer_page, 4);
}

void oled_draw_auto(const uint8_t *bitmap, uint8_t width,
                    uint8_t height, uint8_t col_start, uint8_t page_start)
{
    uint8_t pages = height / 8;
    for (uint8_t p = 0; p < pages; p++)
    {
        oled_draw(bitmap + width * p,
                  width,
                  col_start,
                  col_start + width - 1,
                  page_start + p,
                  page_start + p);
    }
}

void oled_draw_char(uint8_t col_start, uint8_t page_start, char c)
{
    if (c < 32 || c > 127)
    {
        c = '?'; // tránh kí tự lạ
    }
    const uint8_t *bitmap = font5x7_basic[c - 32];
    config_position(col_start, col_start + 4, page_start, page_start);
    for (int i = 0; i < 5; i++)
        master_transmit_data(bitmap[i]);
}

void oled_draw_string(uint8_t col_start, uint8_t page_start, char *str)
{
    config_position(col_start, 127, page_start, page_start);
    while (*str)
    {
        oled_draw_char(col_start, page_start, *str++);
        col_start += 6;
        if (col_start > 127)
        {
            col_start = 0;
            page_start += 1;
        }
    }
}